## binutils/arm-mips-src-20121018/sources/vd_kernel/arch/arm/mach-ccep/Kconfig
```kconfig
######################################################################
#
# 	Kconfig for machine about Costom Consumer Electronics 
# 	
# 	created by tukho.kim@samsung.com
#
######################################################################
#
# May,31,2010:	created by tukho.kim
# 

if ARCH_CCEP

choice 
	prompt "Consumer Electronics"
	default SAMSUNG_VD_DTV_PLATFORM

config  SAMSUNG_VD_DTV_PLATFORM
	bool "Samsung VD DTV Platform"
	help
	  This enables support for Samsung co. VD SoC R&D Group DTV Platform

config  SAMSUNG_VD_BD_PLATFORM
	bool "Samsung VD Blue-ray Platform"
	help
	  This enables support for Samsung co. VD SoC R&D Group Blue-ray Platform
endchoice # Consumer Electronics


if SAMSUNG_VD_DTV_PLATFORM
source "arch/arm/mach-ccep/Kconfig.dtv" 
endif # SAMSUNG_VD_DTV_PLATFORM

if SAMSUNG_VD_BD_PLATFORM
source "arch/arm/mach-ccep/Kconfig.bd" 
endif # SAMSUNG_VD_BD_PLATFORM

#
# Discontigmem support 
#
config MACH_MEMORY_TYPE_SUPPORT
	bool 

if MACH_MEMORY_TYPE_SUPPORT

choice
	prompt "Choose System Memory Type"
	default SDP_SPARSEMEM_SUPPORT

config SDP_SPARSEMEM_SUPPORT
	bool "Sparse memory support"
	select ARCH_SPARSEMEM_ENABLE
	help
	  This enables support sparse memory.

config SDP_DISCONTIGMEM_SUPPORT
	bool "discontinous memory support"
	select ARCH_DISCONTIGMEM_ENABLE
	help
	  This enables support discontinous memory for 2 channel system memory 

config SDP_SINGLE_DDR_A
	bool "only DDR A channel system memory"
	help
	  This enables support only to use A channel for system memory

config SDP_SINGLE_DDR_B
	bool "only DDR B channel system memory"
	help
	  This enables support only to use B channel for system memory

config SDP_SINGLE_DDR_C
	bool "only DDR C channel system memory"
	help
	  This enables support only to use C channel for system memory

endchoice # "Choose System Memory Type"

config USE_EXT_GIC
	bool "Use external GIC and interrupt combiner"
	depends on ARCH_SDP1202 || ARCH_SDP1202FPGA
	help
	  Use external GIC and interrupt combiner
	  instead of internal GIC and interrupt combiner.

menu "Select ARM Errata Patch"

config SDP_ARM_A8_ERRATA_586324
	bool "ARM A8 ERRATA 586324 - cache corruption"
	default y if ARCH_SDP1002 || ARCH_SDP1103 || ARCH_SDP1103FPGA
	help
	  This fix ARM_ERRATA_586324. Cache maintenance operation done by MVA can result in a corruption of memory.

endmenu

endif # MACH_MEMORY_TYPE_SUPPORT

endif # ARCH_CCEP	
```

## binutils/arm-mips-src-20121018/sources/vd_kernel/arch/arm/mach-ccep/Kconfig.bd
```kconfig
######################################################################
#
# 	Kconfig for Samsung VD SoC BD platform
# 	
# 	created by tukho.kim@samsung.com
#
######################################################################
#
# May,31,2010:	created by tukho.kim
# 

if SAMSUNG_VD_BD_PLATFORM

choice 
	prompt "BD Platform (machine)"
	default MACH_FIRENZE

config MACH_FIRENZE
	bool "Firenze platform, 2010"
	select ARCH_SDP1004
	select MACH_MEMORY_TYPE_SUPPORT
	help
	  This enables support for Samsung VD DTV Evaluation board, FIRENZE.

config MACH_FPGA_FIRENZE
	bool "Firenze FPGA platform, 2010"
	select ARCH_SDP1004FPGA
	select MACH_MEMORY_TYPE_SUPPORT
	help
	  This enables support for Samsung VD DTV FPGA board, FIRENZE.

config MACH_VICTORIA
	bool "Victoria platform, 2011"
	select ARCH_SDP1105
	select MACH_MEMORY_TYPE_SUPPORT
	help
	  This enables support for Samsung VD DTV Evaluation board, VICTORIA.

config MACH_FPGA_VICTORIA
	bool "Victoria FPGA platform, 2011"
	select ARCH_SDP1105FPGA
	select MACH_MEMORY_TYPE_SUPPORT
	help
	  This enables support for Samsung VD FPGA board, VICTORIA.


endchoice #"BD Platform (machine)"


endif #SAMSUNG_VD_BD_PLATFORM

config ARCH_SDP1004
	bool
	select CPU_V7
	select VFP
	select NEON

config ARCH_SDP1004FPGA
	bool
	select CPU_V7
	select VFP
	select NEON

config ARCH_SDP1105
	bool
	select CPU_V7
	select VFP
	select NEON
	select ARM_GIC if SMP
	select PL330
	select ARM_ERRATA_743622
	select ARM_ERRATA_751472
	select ARM_ERRATA_754322
	select ARM_ERRATA_764369

config ARCH_SDP1105FPGA
	bool
	select CPU_V7
	select VFP
	select NEON
	select ARM_GIC
	select PL330

config SATA_FIRENZE
	tristate	"Support VD BD SATA"
	depends on ARCH_SDP1004 || ARCH_SDP1105 || ARCH_SDP1105FPGA
#	select ATA
	select ATA_SFF
	select SATA_PMP
	

#
# Define BD SoC chip 
#

if MACH_FIRENZE
source "arch/arm/mach-ccep/firenze/Kconfig"
endif

if MACH_FPGA_FIRENZE
source "arch/arm/mach-ccep/fpga_firenze/Kconfig"
endif

if MACH_VICTORIA
source "arch/arm/mach-ccep/victoria/Kconfig"
endif

if MACH_FPGA_VICTORIA
source "arch/arm/mach-ccep/fpga_victoria/Kconfig"
endif
```

## binutils/arm-mips-src-20121018/sources/vd_kernel/arch/arm/mach-ccep/fpga_flamengo/Kconfig
```kconfig
######################################################################
#
# 	Kconfig for Aquila machine; Samsung VD SoC DTV platform
# 	
# 	created by tukho.kim@samsung.com
#
######################################################################
#
# May,31,2010:	created by tukho.kim
# 

if MACH_FPGA_FLAMENGO

config FPGA_BUSCLKSRC
	int "FPGA Bus clock source(#3 clock) frequency (Hz)"
	default "40625000"

endif # MACH_FPGA_FLAMENGO
```

## binutils/arm-mips-src-20121018/sources/vd_kernel/arch/arm/mach-ccep/fpga_santos/Kconfig
```kconfig
######################################################################
#
# 	Kconfig for Dalma machine; Samsung VD SoC DTV platform
# 	
# 	created by sh.chon@samsung.com
#
######################################################################
#
# Jun,21,2011:	created by sh.chon
# 

if MACH_FPGA_SANTOS

config FPGA_BUSCLKSRC
	int "FPGA Bus clock source(#3 clock) frequency (Hz)"
	default "40625000"

endif # MACH_FPGA_SANTOS
```

## binutils/arm-mips-src-20121018/sources/vd_kernel/arch/arm/mach-ccep/fpga_victoria/Kconfig
```kconfig
######################################################################
#
# 	Kconfig for Firenze machine; Samsung VD SoC DTV platform
# 	
# 	created by tukho.kim@samsung.com
#
######################################################################
#
# May,31,2010:	created by tukho.kim
# 

if MACH_FPGA_VICTORIA

config FPGA_BUSCLKSRC
	int "FPGA Bus clock source(#3 clock) frequency (Hz)"
	default "50000000"

endif # MACH_FPGA_VICTORIA
```

## binutils/arm-mips-src-20121018/sources/vd_kernel/arch/mips/Kconfig.VDLP
```kconfig
menu Samsung

## VDLP MIPS Menu Start: config file for VDLinux 3.x Features ##
menu "Samsung VDLP Option"
comment "VDLinux 3.x"

config SHOW_FAULT_TRACE_INFO
       bool "Show Trace Info on User Page Fault"
       default y
       help
        Show trace information when occurred "Segmentation Fault" or "Bus Error"
        Prints registers, call stack, maps, user stack, etc.

config SHOW_EPC_RA_INFO
	bool "show address range including epc, ra"
	depends on SHOW_FAULT_TRACE_INFO
	default y

config SERIAL_INPUT_MANIPULATION
    bool "Manipulate serial input in N_TTY"
    help
      Decide whether serial input by user is enabled or not.

config SERIAL_INPUT_ENABLE_STRING
    string "Serial input enable string"
    default "debug"
    depends on SERIAL_INPUT_MANIPULATION=y
    help
      Default string that enable serial input by user.

config SERIAL_INPUT_DISABLE_STRING
    string "Serial input disable string"
    default "~~bye"
    depends on SERIAL_INPUT_MANIPULATION=y
    help
      Default string that disable serial input by user.

config SERIAL_INPUT_DEFAULT_SETUP_ENABLE
    bool "Serial input enable setup at boot"
    default y
    depends on SERIAL_INPUT_MANIPULATION=y

config SERIAL_INPUT_MANIPULATION_PORTNUM
    int "Serial input port line number"
    default 0
    depends on SERIAL_INPUT_MANIPULATION=y

config SERIAL_INPUT_ENABLE_ONLY_NUMBER
    bool "Enable only 0~9, space, enter and backspace as serial input"
    default n
    depends on SERIAL_INPUT_MANIPULATION=y

config SERIAL_INPUT_ENABLE_HELP_MSG
    bool "Print help message for serial input"
    default y
    depends on SERIAL_INPUT_MANIPULATION=y

config VDLP_VERSION_INFO
       bool "display kernel, patch number info"
       default y
       help
               print kernel, patch number info.
config SEPARATE_PRINTK_FROM_USER
	bool "It separate messgaes(printf, printk) between user and kernel."
	default y 

config RSS_INFO
       bool "Support to print rss information of process memory"
       default y
       help
         Enable to print information of rss

config PSS_INFO
       bool "Support to print pss information of process memory"
       default y
       depends on PROC_PAGE_MONITOR
       help
         Enable to print information of pss

config CHECK_USERMODE_ADE_EMULATE
       bool "called load store emulate insn in user mode, send SIGBUS"
       default y
       help
        If check this option, send SIGBUS. If not, just print error and debug message.

config PRINT_KILL_SIGNAL
    bool "Print kill signal debug message"
    default n
    help
      Print debug message when kill signal is raised.

config SKIP_CHECKING_MEMORY_WHILE_FORK
       bool "Workaround glibc system() fail problem"
       default y
       help
        workaround glibc system faile problem.

config INFINITE_OOPS_DISPLAY
    bool "Infinite oops display"
    default y
    help
      Reprint oops log inifinitely(every 3 minute).

config LPJ_MANUAL_SETTING
    bool "LPJ value manual setting"
    default y
    help
      Manually set the loops_per_jiffy value, to skip calibrating delay loop
      on boot to improve boot time.
      Pls note that for each architecture this value is different, therefore
      first run target without this patch to get value.
      Once value is found from boot message log, enable this option and
      assign value to "Manual LPJ value"

config LPJ_VALUE
    int "Manual LPJ Value"
    default 0
    depends on LPJ_MANUAL_SETTING=y
    help
      Find value for your architecture before setting this.

config VFAT_FS_DUALNAMES
    bool "VFAT dual names support"
    depends on VFAT_FS
    help
      This option provides support for dual filenames on VFAT filesystems.
      If this option is disabled then file creation will either put
      a short (8.3) name or a long name on the file, but never both.
      The field where a shortname would normally go is filled with
      invalid characters such that it cannot be considered a valid
      short filename.
      That means that long filenames created with this option
      disabled will not be accessible at all to operating systems
      that do not understand the VFAT extensions.
      Users considering enabling this option should consider the implications
      of any patents that may exist on dual filenames in VFAT.

      If unsure, say N

config DEBUG_STACKOVERFLOW
       bool "Check for stack overflows"
       help
        This option will cause messages to be printed if free stack space
        drops below a certain limit.

config PRINT_MODULE_ADDR
       bool "Print Loaded Module Address"
       default y
       help
        print Loaded module address

config DUMP_RANGE_BASED_ON_REGISTER
       bool "dump register value"
       default y
       help
        dump a specific range of addr bases on register.
        depends on CONFIG_SHOW_PC_LR_INFO

endmenu # end of "Samsung VDLP Option" menu
endmenu # end of "Samsung" menu
```
