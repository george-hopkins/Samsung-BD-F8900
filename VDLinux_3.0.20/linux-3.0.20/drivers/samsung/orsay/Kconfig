## VDLinux_3.0.20/linux-3.0.20/drivers/samsung/orsay/Kconfig
```kconfig
menu "Orsay Platform Support"

config ORSAY_VDBINDER_IPC
	bool "VDBinder IPC Driver"
	default y

config ORSAY_ASHMEM
	bool "VDBinder Ashmem Driver"
	default y

config ORSAY_DEBUG
	bool "VDBinder DEBUG"
	depends on ORSAY_VDBINDER_IPC
	default y

config ORSAY_CHECK_TODO_WORKENTRY
        bool "Check work list entry in thread or proc todo list"
        depends on ORSAY_VDBINDER_IPC
        default n

endmenu
```

## VDLinux_3.0.20/linux-3.0.20/drivers/staging/android/Kconfig
```kconfig
menu "Android"

config ANDROID
	bool "Android Drivers"
	default N
	---help---
	  Enable support for various drivers needed on the Android platform

if ANDROID

config ANDROID_LOW_MEMORY_KILLER
	bool "Android Low Memory Killer"
	default N
	---help---
	  Register processes to be killed when memory is low

config SIGNAL_POLICY
	bool "Enable signal policy feature"
	default n
	help
	  If enabled then specified user-space programs (filtered by task name)
	  are restricted by special rules for setting, unsetting and
	  masking of specified signals. 

endif # if ANDROID

endmenu
```

## VDLinux_3.0.20/linux-3.0.20/fs/emmcfs/Kconfig
```kconfig
config EMMCFS_FS
	tristate "Samsung eMMCFS file system support (EXPERIMENTAL)"
	depends on BLOCK && EXPERIMENTAL
	select NLS
	select CRC32
	default n
	help
	  If you say Y here, you will be able to mount format
	  eMMCFS-formatted hard drive partitions with full read-write access.

	  To compile this code as a module, choose M here: the module will be
	  called emmcfs.

	  If unsure, say N.

config EMMCFS_DEBUG
	bool "Debug eMMCFS"
	depends on EMMCFS_FS
	help
	  If you say Y here, you can use the 'debug' mount option to enable
	  debugging output from the driver.

	  If unsure, say N.

config EMMCFS_NOOPTIMIZE
	bool "Disable build optimization for eMMCFS"
	depends on EMMCFS_FS
	help
	  If you say Y here, eMMCFS will be built with -O0 opt. Useful for
	  gdb debug;

	  If unsure, say N.

config EMMCFS_PROC_INFO
	bool "Stats in /proc/fs/emmcfs"
	depends on EMMCFS_FS && PROC_FS
	help
	  Create under /proc/fs/emmcfs a hierarchy of files, displaying
	  various eMMCFS statistics and internal data.

	  If unsure, say N.

config EMMCFS_EXPERIMENTAL
	bool "EMMCFS Experimental Features (EXPERIMENTAL)"
	depends on EMMCFS && EXPERIMENTAL
	help
	  Enables eMMCFS features under testing. These features are
	  experimental.

	  If unsure, say N.

config EMMCFS_OLDEST_LAYOUT_VERSION
	int "The oldest supported version of on-disk layout"
	default 331
	range 331 9999
	depends on EMMCFS_FS
	help
	  
	  eMMCFS volume should be formated by mkfs.emmcfs utility not older
	  than specified version.
	  Older versions will be rejected by driver at mount time.

	  Cann't be less then 331
	  
	  If unsure, leave default value

config EMMCFS_CRC_CHECK
	bool "EMMCFS Bnodes CRC check"
	depends on EMMCFS_FS
	help
		Enables CRC check for eMMCFS bnodes
		
		If unsure, say N. 
```

## VDLinux_3.0.20/linux-3.0.20/security/tomoyo/Kconfig
```kconfig
config SECURITY_TOMOYO
	bool "TOMOYO Linux Support"
	depends on SECURITY
	depends on NET
	select SECURITYFS
	select SECURITY_PATH
	select SECURITY_NETWORK
	default n
	help
	  This selects TOMOYO Linux, pathname-based access control.
	  Required userspace tools and further information may be
	  found at <http://tomoyo.sourceforge.jp/>.
	  If you are unsure how to answer this question, answer N.

config SECURITY_TOMOYO_DISABLE
	bool "Disable TOMOYO hook at boot time"
	depends on SECURITY
	depends on NET
	select SECURITYFS
	select SECURITY_PATH
	select SECURITY_NETWORK
	default	y
	help
	  This config option will disable TOMOYO hooks at boot time.
	  If this option is on then TOMOYO hooks will not be called
	  from LSM hook.By default this option is ON.

config SECURITY_TOMOYO_MAX_ACCEPT_ENTRY
	int "Default maximal count for learning mode"
	default 2048
	range 0 2147483647
	depends on SECURITY_TOMOYO
	help
	  This is the default value for maximal ACL entries
	  that are automatically appended into policy at "learning mode".
	  Some programs access thousands of objects, so running
	  such programs in "learning mode" dulls the system response
	  and consumes much memory.
	  This is the safeguard for such programs.

config SECURITY_TOMOYO_MAX_AUDIT_LOG
	int "Default maximal count for audit log"
	default 1024
	range 0 2147483647
	depends on SECURITY_TOMOYO
	help
	  This is the default value for maximal entries for
	  audit logs that the kernel can hold on memory.
	  You can read the log via /sys/kernel/security/tomoyo/audit.
	  If you don't need audit logs, you may set this value to 0.

config SECURITY_TOMOYO_OMIT_USERSPACE_LOADER
	bool "Activate without calling userspace policy loader."
	default n
	depends on SECURITY_TOMOYO
	---help---
	  Say Y here if you want to activate access control as soon as built-in
	  policy was loaded. This option will be useful for systems where
	  operations which can lead to the hijacking of the boot sequence are
	  needed before loading the policy. For example, you can activate
	  immediately after loading the fixed part of policy which will allow
	  only operations needed for mounting a partition which contains the
	  variant part of policy and verifying (e.g. running GPG check) and
	  loading the variant part of policy. Since you can start using
	  enforcing mode from the beginning, you can reduce the possibility of
	  hijacking the boot sequence.

config SECURITY_TOMOYO_POLICY_LOADER
	string "Location of userspace policy loader"
	default "/sbin/tomoyo-init"
	depends on SECURITY_TOMOYO
	depends on !SECURITY_TOMOYO_OMIT_USERSPACE_LOADER
	---help---
	  This is the default pathname of policy loader which is called before
	  activation. You can override this setting via TOMOYO_loader= kernel
	  command line option.

config SECURITY_TOMOYO_ACTIVATION_TRIGGER
	string "Trigger for calling userspace policy loader"
	default "/sbin/init"
	depends on SECURITY_TOMOYO
	depends on !SECURITY_TOMOYO_OMIT_USERSPACE_LOADER
	---help---
	  This is the default pathname of activation trigger.
	  You can override this setting via TOMOYO_trigger= kernel command line
	  option. For example, if you pass init=/bin/systemd option, you may
	  want to also pass TOMOYO_trigger=/bin/systemd option.

config SECURITY_TOMOYO_RESTRICT_PRIVILEGE
        bool "Activate Restrict Privilege feature."
        default n
        depends on SECURITY_TOMOYO
        ---help---
          Say Y if you want to restrict the privilege of new process
          created from a process running as a root. You have to configure
          the binary path with restrict_privilege directive in exception
          policy to restrict the privilege of child process.

config SECURITY_TOMOYO_MANAGER
        bool "Enable TOMOYO MANAGER functionality."
        default n
        depends on SECURITY_TOMOYO
        ---help---
          Say Y if you want to enable TOMOYO manager functionality.
	  By default TOMOYO manager functionality is disabled. Instead
	  of manager, Kernel config has been given option to configure
	  the tools who can update TOMOYO policies.

config SECURITY_TOMOYO_POLICY_READ
        bool "Allow user to read TOMOYO Policy."
        default y 
        depends on SECURITY_TOMOYO
        ---help---
          Say n if you do not want to allow security tool to read TOMOYO policy.
          On DTV due to security reasons we do not want to allow every user
          to read TOMOYO policies. So only configured tool can read policy.

config SECURITY_TOMOYO_POLICY_READER_NAME
        string "Location of TOMOYO tool to read policy."
        default "/mtd_exe/Comp_LIB/daa"
        depends on SECURITY_TOMOYO
        depends on SECURITY_TOMOYO_POLICY_READ
        ---help---
          This is the default pathname of TOMOYO tool to read policy.
          On DTV due to security reasons we do not want to allow every user
          to read TOMOYO policies. We want to configure the tool name which
          can read TOMOYO policies. You can override this setting via kernel
	  command line option.

config SECURITY_TOMOYO_POLICY_UPDATE
        bool "Allow security tool to update TOMOYO Policy."
        default y
        depends on SECURITY_TOMOYO
	depends on !SECURITY_TOMOYO_MANAGER
        ---help---
          Say n if you do not want to allow security tool to update TOMOYO policy.
          On DTV due to security reasons we do not want to allow every user
          to update TOMOYO policies. So only configured tool can update policy.

config SECURITY_TOMOYO_POLICY_WRITER_NAME
        string "Location of TOMOYO tool to update policy."
        default "/mtd_exe/Comp_LIB/daa"
        depends on SECURITY_TOMOYO
        depends on SECURITY_TOMOYO_POLICY_UPDATE
	depends on !SECURITY_TOMOYO_MANAGER
        ---help---
          This is the default pathname of TOMOYO tool to update policy.
          On DTV due to security reasons we do not want to allow every user
          to update TOMOYO policies. We want to configure the tool name which
          can update TOMOYO policies. You can override this setting via kernel
          command line option.

config SECURITY_TOMOYO_LOG_READER
        bool "Allow configured tool to read TOMOYO audit log."
        default y 
        depends on SECURITY_TOMOYO
        ---help---
	  Say n if you want to allow all user to read TOMOYO audit logs.
	  On DTV due to security reasons we want to allow only configured
	  tool to read TOMOYO audit log.

config SECURITY_TOMOYO_LOG_READER_NAME
        string "Location of TOMOYO audit log reader."
        default "/mtd_exe/Comp_LIB/daa"
        depends on SECURITY_TOMOYO
	depends on SECURITY_TOMOYO_LOG_READER
        ---help---
          This is the default pathname of TOMOYO audit log reader.
          On DTV due to security reasons we do not want that any user can read TOMOYO
          audit log. We want to configure the tool name which can read TOMOYO audit log.
          You can override this setting via kernel command line option.
```

## binutils/arm-mips-src-20121018/build.arm.cortex-a15/sources/kernel-headers/arch/arm/Kconfig.VDLP
```kconfig
menu "Samsung"

## VDLP ARM Menu Start: config file for VDLinux 3.x Features ##
menu "Samsung VDLP options"
comment "VDLinux 3.x"

config SHOW_FAULT_TRACE_INFO
    bool "Show trace info on user page fault"
    default y
    help
      Shows trace information when "Segmentation fault" or "Bus error" occurs.
      Prints registers, call stack, maps, user stack, etc.

config SHOW_THREAD_GROUP_STACK
    bool "Show thread group's stack on user page fault"
    default n
    depends on SHOW_FAULT_TRACE_INFO
    help
      Shows thread group's user stack along with basic fault trace information.
      It may be useful where fault occurs in one thread, but another thread is
      a criminal.
      Be careful, dumping all threads stack can generate very long message.

config DISABLE_UNALIGNED_ACCESS
       bool "not support unaligned access"
       default y
       depends on ALIGNMENT_TRAP
       help
        not support unaligned access.


config SHOW_PC_LR_INFO
    bool "Show address range including PC, LR"
    depends on SHOW_FAULT_TRACE_INFO
    default y

config SERIAL_INPUT_MANIPULATION
    bool "Manipulate serial input in N_TTY"
    help
      Decide whether serial input by user is enabled or not.

config SERIAL_INPUT_ENABLE_STRING
    string "Serial input enable string"
    default "debug"
    depends on SERIAL_INPUT_MANIPULATION=y
    help
      Default string that enable serial input by user.

config SERIAL_INPUT_DISABLE_STRING
    string "Serial input disable string"
    default "~~bye"
    depends on SERIAL_INPUT_MANIPULATION=y
    help
      Default string that disable serial input by user.

config SERIAL_INPUT_DEFAULT_SETUP_ENABLE
    bool "Serial input enable setup at boot"
    default y
    depends on SERIAL_INPUT_MANIPULATION=y

config SERIAL_INPUT_MANIPULATION_PORTNUM
    int "Serial input port line number"
    default 0
    depends on SERIAL_INPUT_MANIPULATION=y

config SERIAL_INPUT_ENABLE_ONLY_NUMBER
    bool "Enable only 0~9, space, enter and backspace as serial input"
    default n
    depends on SERIAL_INPUT_MANIPULATION=y

config SERIAL_INPUT_ENABLE_HELP_MSG
    bool "Print help message for serial input"
    default y
    depends on SERIAL_INPUT_MANIPULATION=y

config SEPARATE_PRINTK_FROM_USER
    bool "It separate messages(printf, printk) between user and kernel."
    default y 

config RSS_INFO
       bool "Support to print rss information of process memory"
       default y
       help
         Enable to print information of rss

config PSS_INFO
       bool "Support to print pss information of process memory"
       default y
       depends on PROC_PAGE_MONITOR
       help
         Enable to print information of pss

config VDLP_VERSION_INFO
    bool "Display kernel, patch number info"
    default y
    help
      Print kernel, patch number info.

config PRINT_KILL_SIGNAL
    bool "Print kill signal debug message"
    default n
    help
      Print debug message when kill signal is raised.

config SKIP_CHECKING_MEMORY_WHILE_FORK
       bool "Workaround glibc system() fail problem"
       default y
       help
        workaround glibc system faile problem.

config INFINITE_OOPS_DISPLAY
    bool "Infinite oops display"
    default y
    help
      Reprint oops log inifinitely(every 3 minute).

config LPJ_MANUAL_SETTING
    bool "LPJ value manual setting"
    default y
    help
      Manually set the loops_per_jiffy value, to skip calibrating delay loop
      on boot to improve boot time.
      Pls note that for each architecture this value is different, therefore
      first run target without this patch to get value. 
      Once value is found from boot message log, enable this option and 
      assign value to "Manual LPJ value"
    
config LPJ_VALUE
    int "Manual LPJ Value"
    default 0
    depends on LPJ_MANUAL_SETTING=y
    help
      Find value for your architecture before setting this. 
    
config VFAT_FS_DUALNAMES
    bool "VFAT dual names support"
    depends on VFAT_FS
    help
      This option provides support for dual filenames on VFAT filesystems.
      If this option is disabled then file creation will either put
      a short (8.3) name or a long name on the file, but never both.
      The field where a shortname would normally go is filled with
      invalid characters such that it cannot be considered a valid
      short filename.
      That means that long filenames created with this option
      disabled will not be accessible at all to operating systems
      that do not understand the VFAT extensions.
      Users considering enabling this option should consider the implications
      of any patents that may exist on dual filenames in VFAT.

      If unsure, say N

config DEBUG_STACKOVERFLOW
       bool "Check for stack overflows"
       help
        This option will cause messages to be printed if free stack space
        drops below a certain limit.

config PRINT_MODULE_ADDR
       bool "Print Loaded Module Address"
       default y
       help
        print Loaded module address

config DUMP_RANGE_BASED_ON_REGISTER
       bool "dump register value"
       default y
       help
        dump a specific range of addr bases on register.
        depends on CONFIG_SHOW_PC_LR_INFO

endmenu # end of "Samsung VDLP options" menu
endmenu # end of "Samsung" menu
```

## binutils/arm-mips-src-20121018/build.arm.cortex-a15/sources/kernel-headers/arch/arm/mach-ccep/fpga_firenze/Kconfig
```kconfig
if MACH_FPGA_FIRENZE

config FPGA_FIRENZE_BUSCLKSRC
	int "FPGA Bus clock source(#3 clock) frequency (Hz)"
	default "6250000"

endif
```

## binutils/arm-mips-src-20121018/build.arm.cortex-a15/sources/kernel-headers/arch/arm/mach-ccep/fpga_genoa/Kconfig
```kconfig
if MACH_FPGA_GENOA

config FPGA_GENOA_BUSCLKSRC
	int "FPGA Bus clock source(#3 clock) frequency (Hz)"
	default "35900000"

endif
```
