## VDLinux_3.0.20/linux-3.0.20/arch/arm/mach-ccep/Kconfig.dtv
```kconfig
######################################################################
#
# 	Kconfig for Samsung VD SoC DTV platform
# 	
# 	created by tukho.kim@samsung.com
#
######################################################################
#
# May,31,2010:	created by tukho.kim
# 

# Choose DTV Platform 
if SAMSUNG_VD_DTV_PLATFORM

choice 
	prompt "DTV Platform (machine)"
	default MACH_GRIFFIN

config MACH_GRIFFIN
	bool "Griffin platform, 2010"
	select ARCH_SDP1001
	select MACH_MEMORY_TYPE_SUPPORT
	help
	  This enables support for Samsung VD DTV Evaluation board, GRIFFIN.

config MACH_FPGA_GENOA
	bool "GENOA FPGA platform, 2010"
	select ARCH_SDP1001FPGA
	select MACH_MEMORY_TYPE_SUPPORT
	help
	  This enables support for Samsung VD DTV Genoa FPGA board.

config MACH_DALMA
	bool "Dalma platform, 2010"
	select ARCH_SDP1002
	select MACH_MEMORY_TYPE_SUPPORT
	help
	  This enables support for Samsung VD DTV Evaluation board, DALMA.

config MACH_FLAMENGO
	bool "Flamengo platform, 2011"
	select ARCH_SDP1106
	select MACH_MEMORY_TYPE_SUPPORT
	help
	  This enables support for Samsung VD DTV Evaluation board, FLAMENGO.

config MACH_FPGA_FLAMENGO
	bool "Flamengo FPGA platform, 2011"
	select ARCH_SDP1106FPGA
	select MACH_MEMORY_TYPE_SUPPORT
	help
	  This enables support for Samsung VD DTV FPGA board, FLAMENGO.

config MACH_SANTOS
	bool "Santos platform, 2011"
	select ARCH_SDP1103
	select MACH_MEMORY_TYPE_SUPPORT
	help
	  This enables support for Samsung VD DTV Evaluation board, SANTOS

config MACH_FPGA_SANTOS
	bool "Santos FPGA platform, 2011"
	select ARCH_SDP1103FPGA
	select MACH_MEMORY_TYPE_SUPPORT
	help
	  This enables support for Samsung VD DTV FPGA board, SANTOS

config MACH_ECHOE
	bool "Echo-E platform, 2011"
	select ARCH_SDP1114
	select MACH_MEMORY_TYPE_SUPPORT
	help
	  This enables support for Samsung VD DTV Evaluation board, Echo-E

config MACH_FOXAP
	bool "Fox-AP platform, 2012"
	select ARCH_SDP1202
	select MACH_MEMORY_TYPE_SUPPORT
	help
	  This enables support for Samsung VD DTV Evaluation board, FOX-AP

config MACH_FPGA_FOXAP
	bool "Fox-AP FPGA platform, 2012"
	select ARCH_SDP1202FPGA
	select MACH_MEMORY_TYPE_SUPPORT
	help
	  This enables support for Samsung VD DTV FPGA board, FOX_AP

endchoice #"DTV Platform (machine)"

endif #SAMSUNG_VD_DTV_PLATFORM

#
# Define DTV SoC chip
#

# SDP1001 GenoaS, Cortex-A9, Neon, 32KB/32KB/256KB
config ARCH_SDP1001
	bool
	select ARCH_CCEP_SOC_CA9

config ARCH_SDP1002
	bool
	select ARCH_CCEP_SOC_CA8
#	select CPU_V7
#	select VFP
#	select NEON

config ARCH_SDP1103
	bool
	select ARCH_CCEP_SOC_CA9
#	select CPU_V7
#	select VFP
#	select NEON
#	select PL330

config ARCH_SDP1106
	bool
	select ARCH_CCEP_SOC_CA9
#	select CPU_V7
#	select VFP
#	select NEON
	select ARM_GIC
#	select PL330
#	select ARM_ERRATA_743622
#	select ARM_ERRATA_751472
#	select ARM_ERRATA_754322
#	select ARM_ERRATA_764369

config ARCH_SDP1114
	bool
	select ARCH_CCEP_SOC_CA9
#	select CPU_V7
#	select VFP
#	select NEON
	select ARM_GIC
#	select ARM_ERRATA_743622
#	select ARM_ERRATA_751472
#	select ARM_ERRATA_754322
#	select ARM_ERRATA_764369

config ARCH_SDP1103FPGA
	bool
	select ARCH_CCEP_SOC_CA9
#	select CPU_V7
#	select VFP
#	select NEON
#	select PL330

config ARCH_SDP1106FPGA
	bool
	select ARCH_CCEP_SOC_CA9
#	select CPU_V7
#	select VFP
#	select NEON
#	select ARM_GIC if SMP
#	select PL330

config ARCH_SDP1202
	bool
	select ARCH_CCEP_SOC_CA15
#	select CPU_V7
#	select VFP
#	select NEON
#	select ARM_GIC
#	select PL330
	select SDP_TIMER_SCALING

config ARCH_SDP1202FPGA
	bool
	select ARCH_CCEP_SOC_CA15
	select ARCH_CCEP_FPGA
#	select CPU_V7
#	select ARM_GIC
#	select PL330


if MACH_GRIFFIN
source "arch/arm/mach-ccep/platform/griffin/Kconfig"
endif # MACH_GRIFFIN

if MACH_FPGA_GENOA
source "arch/arm/mach-ccep/platform/fpga_genoa/Kconfig"
endif # MACH_GRIFFIN

if MACH_DALMA
source "arch/arm/mach-ccep/platform/dalma/Kconfig"
endif # MACH_DALMA

if MACH_FLAMENGO
source "arch/arm/mach-ccep/platform/flamengo/Kconfig"
endif # MACH_FLAMENGO

if MACH_SANTOS
source "arch/arm/mach-ccep/platform/santos/Kconfig"
endif # MACH_SANTOS

if MACH_ECHOE
source "arch/arm/mach-ccep/platform/echoe/Kconfig"
endif # MACH_ECHOE

if MACH_FPGA_FLAMENGO
source "arch/arm/mach-ccep/platform/fpga_flamengo/Kconfig"
endif # MACH_FPGA_FLAMENGO

if MACH_FPGA_SANTOS
source "arch/arm/mach-ccep/platform/fpga_santos/Kconfig"
endif # MACH_FPGA_SANTOS

if MACH_FOXAP
source "arch/arm/mach-ccep/platform/foxap/Kconfig"
endif # MACH_FOXAP

if MACH_FPGA_FOXAP
source "arch/arm/mach-ccep/platform/fpga_foxap/Kconfig"
endif # MACH_FPGA_FOXAP
```

## VDLinux_3.0.20/linux-3.0.20/arch/arm/mach-ccep/platform/foxap/Kconfig
```kconfig
######################################################################
#
# 	Kconfig for Aquila machine; Samsung VD SoC DTV platform
# 	
# 	created by tukho.kim@samsung.com
#
######################################################################
#
# May,31,2010:	created by tukho.kim
# 

if MACH_FOXAP

config FOXAP_SMC_SPI
	tristate "SDP SPI Master controller devices on external bus"
	default n
	depends on SDP_SPI
	help
	  SPI controller devices integrated within One-connection serdes FPGAs
	  These devices are accessible by SDP SMC external bus.

endif # MACH_FOXAP
```

## VDLinux_3.0.20/linux-3.0.20/arch/arm/mach-ccep/platform/fpga_foxap/Kconfig
```kconfig
######################################################################
#
# 	Kconfig for Fox-MP machine; Samsung VD SoC DTV platform
# 	
# 	created by sh.chon@samsung.com
#
######################################################################
#
# May,31,2010:	created by tukho.kim
# Nov,12,2011:  modified by sh.chon
# 

if MACH_FPGA_FOXAP

config FPGA_BUSCLKSRC
	int "FPGA Bus clock source(#3 clock) frequency (Hz)"
	default "112500000"

endif # MACH_FPGA_FOXAP
```

## VDLinux_3.0.20/linux-3.0.20/arch/arm/mach-ccep/platform/fpga_foxb/Kconfig
```kconfig
######################################################################
#
# 	Kconfig for Firenze machine; Samsung VD SoC DTV platform
# 	
# 	created by tukho.kim@samsung.com
#
######################################################################
#
# Apr,09,2012:	created by tukho.kim
# 

if MACH_FPGA_FOXB

config FPGA_BUSCLKSRC
	int "FPGA Bus clock source(#3 clock) frequency (Hz)"
	default "50000000"

endif # MACH_FPGA_FOXB
```

## VDLinux_3.0.20/linux-3.0.20/arch/arm/plat-ccep/Kconfig
```kconfig
######################################################################
#
# 	Kconfig for platform device about Samsung Costom Consumer Electronics 
# 	
# 	created by tukho.kim@samsung.com
#
######################################################################
#
# May,31,2010:	created by tukho.kim
# 

if ARCH_CCEP

menu "Samsung CCEP Implementation"

#
# using WFI instruction or not use it 
#
comment "WFI instruction"
config POLL_INTR_PEND
	bool "Polling interrupt pending register instead of WFI instruction"
	default y

#
# Interrupt controller option 
#
#comment "Interrupt Controller option"
#choice
#	prompt "Interrupt policy"
#	default INTC_PRIORITY

#config INTC_PRIORITY
#	bool "Priority support"

#config INTC_NOT_NESTED
#	bool "Not support to be nested"

#config INTC_NONE
#	bool "none"

#endchoice
config SDP_INTC64
	bool




#
# UART controller option 
#
comment "UART Controller option"
config SERIAL_SDP
	tristate "UART Controller support"
	depends on ARCH_CCEP
	select SERIAL_CORE

config SERIAL_SDP_CONSOLE
	bool "Support Serial Console"
	depends on SERIAL_SDP=y
	select SERIAL_CORE_CONSOLE
	

#
# I2C controller option 
#
comment "I2C Controller option"
config SDP_I2C
	tristate "custom I2C Driver"
	default y
	
config SDP_I2C_WR_WR_RD
	depends on SDP_I2C
	bool "I2C Write:Write:Read frame support"

#
# PCI express
#
comment "PCI express RC/EP option"

config 	SDP_PCIE
	depends on PCI && (ARCH_SDP92 || ARCH_SDP1002 || ARCH_SDP1004 ||  ARCH_SDP1106)
	bool "Support PCI Express 1.0/2.0 Root complex"

config	SDP_PCIE_EP
	depends on !SDP_PCIE && (ARCH_SDP92 || ARCH_SDP1002 || ARCH_SDP1106)
	tristate "Support PCI Express 1.0/2.0 Endpoint"

#
# GPIO
#

comment "SDP GPIO option"

config SDP_GPIO
	depends on !ARCH_CCEP_FPGA
	bool "Support SDP GPIO"
	default y

config SDP_SMC
	depends on !ARCH_CCEP_FPGA
	bool "Support SDP SMC"

config SDP_SMC_DMA
	depends on SDP_SMC
	bool "Support SMC DMA"
#
# MAC
#

comment "Ethernet MAC option"
config SDP_MAC
        depends on !ARCH_CCEP_FPGA
        tristate "Ethernet MAC Driver"
        select NET
        select INET
        select NETDEVICES
        select MII
        select ETHERNET
        select PHYLIB
        select DEBUG_FS

config SDP_MAC_DEBUG
		depends on SDP_MAC
		bool "Print Debug Msg for SDP MAC"


if SDP_MAC

# Use Normal Descriptor
config SDP_MAC_NORMAL_DESC
		default n
		bool

choice
        prompt "MAC set mac address"
        default MAC_SET_BY_USER

config MAC_GET_I2C
        bool    "MAC get mac address from i2c device" if (SDP_I2C=y)

config MAC_SET_BY_USER
        depends on SDP_MAC
        bool    "MAC set mac address by user"

endchoice


if MAC_GET_I2C
config MAC_I2C_PORT
        depends on MAC_GET_I2C
        int     "MAC i2c device port number"
        default 1

config MAC_I2C_SLV_ADDR
        depends on MAC_GET_I2C
        hex     "MAC i2c device slave address"
        default 0xA0

config MAC_I2C_SUBADDR_NR
        depends on MAC_GET_I2C
        int     "MAC i2c number of sub addresses"
        default 2

config MAC_I2C_SUBADDR
        depends on MAC_GET_I2C
        hex     "MAC i2c sub address"
        default 0x10
endif # MAC_GET_I2C

if MAC_SET_BY_USER
config MAC_FRONT_4BYTE
        depends on MAC_SET_BY_USER
        hex     "MAC Mac address front 4 byte"
        default 0xFFFFFFFF

config MAC_END_2BYTE
        depends on MAC_SET_BY_USER
        hex     "MAC Mac address end 2 byte"
        default 0xFFFF
endif # MAC_SET_BY_USER

endif # SDP_GMAC

#
# eMMC
#
comment "MMC Controller"
config SDP_MMC
	depends on ARCH_CCEP
	tristate "MMC Controller"
	default y
	select MMC

if SDP_MMC
config SDP_MMC_DMA
	bool "MMC DMA mode"
	default y
endif # SDP_MMC


config SDP_MMC_FIXUP_SANDISK_DDR
	bool "SanDisk Card Bugfix"
	default y
	depends on SDP_MMC
	help
		FIXUP : SanDisk Manufacturer ID : consumer 0x45, Engineer Sample 0x02(old)
		add delay in mmc_ios.c




#
# add sdp-spi menu
#
config SDP_SPI
	tristate "SDP SPI Master Controller Driver"
	default n
	depends on ARCH_CCEP
	select SPI
	select SPI_MASTER
	help
	  SDP SPI Master Controller Driver.

config SDP_SPI_NUM_OF_CS
	int "Number of chip select."
	default 1
	depends on SDP_SPI
	help
	  Default CS is 1, but if you used the GPIO CS, CS can be larger than 1.

config SDP_SPIDEV
	tristate "User Level SPI Device Driver for SDP SPI"
	depends on SDP_SPI

config SDP_SPI_DEBUG
	bool "Print Debug Msg for SDP SPI"
	depends on SDP_SPI




#
# add sdp-dma330 menu
#
config SDP_DMA330
	tristate "SDP DMA330 Controller Driver"
	default n
	depends on (ARCH_SDP1106 || ARCH_SDP1105 || ARCH_SDP1202FPGA || ARCH_SDP1202 || ARCH_SDP1207 )
	select DMADEVICES
	select DMA_ENGINE


config SDP_DMADEV
	tristate "SDP DMADEV : Using user mode DMA"
	default n
	depends on SDP_DMA330

config SDP_DMATEST
	tristate "SDP DMATEST : Simple DMA test client."
	default n
	depends on SDP_DMA330

config SDP_DMA330_DEBUG
	bool "Print Debug Msg for SDP DMA330"
	depends on SDP_DMA330

comment "Gzip Decompressor"

config SDP_UNZIP
	bool "SDP GZIP decompressor for Squashfs"
	default n
	depends on (ARCH_SDP1202 || ARCH_SDP1207)
config SDP_UNZIP_TEST_DRIVER
	tristate "SDP GZIP decompressor Driver for Test"
	default n
	depends on SDP_UNZIP

comment "Power Saving"

config SDP_CLOCK_GATING
	bool "Enable Clock Gating for Power-saving"
	default n

#
# Thermal Management
#
comment "Thermal Management"
config SDP_THERMAL
	depends on ARCH_CCEP && CPU_FREQ
	bool "Thermal Management"
	default y

#
# Local timer scaling for CPUFREQ
#
comment "Local timer scaling"
config SDP_TIMER_SCALING
	depends on ARCH_CCEP && CPU_FREQ
	bool "Local timer scaling for DVFS"

endmenu 

endif # ARCH_CCEP
```

## VDLinux_3.0.20/linux-3.0.20/arch/mips/Kconfig.Secure
```kconfig
#menu Samsung

## SELP Menu Start: config file  for SELP Features #############################
## MS.PARK 08.07
menu "CI+ Option"

config EXECUTE_AUTHULD
       default n
       bool "Execute authuld program on background"
       help
         decide whether executing authuld

config RSA1024
	bool "RSA1024 setting"
	default y if NVT_NT72568 || MSTAR_EMERALD # NT12, X13
        depends on EXECUTE_AUTHULD=y

config SHUTDOWN
        bool "Send shutdown signal to micom"
        default n
        depends on EXECUTE_AUTHULD=y
        help
          decide whether send "shutdown" to micom or not

config AUTHULD_PATH
        string "Path to authuld file"
        default "/bin/authuld"
        depends on EXECUTE_AUTHULD=y
        help
          Allows to redirect authuld files into specified location.

config TIMEOUT_ACK_AUTHULD
        int "Timout of authuld ack(minute)"
        default 3
        depends on EXECUTE_AUTHULD=y
        help
          if kernel do not get ACK from authuld, System will be down.

config MOUNT_SECURITY
	bool "security on mount command"
	default n
	help
	  In case of release kernel build mode, This option will disable BIND option and apply NOEXEC option to all devices on mount command 

config USE_ARS
	bool "Anit RemoteShell Dummy function"
	default n
	
endmenu # end of "CI+ Option" menu

#endmenu
```

## VDLinux_3.0.20/linux-3.0.20/arch/mips/nvt-boards/Kconfig
```kconfig
# Config Novatek Platform

menu "Novatek config"

choice 
	prompt "Novatek Chip Selection"
	default NVT_NT72568

config NVT_NT72568
	bool "Novatek NT72568 board"
	select DMA_NONCOHERENT
	select ARCH_SPARSEMEM_ENABLE
	select IRQ_GIC
	select IRQ_CPU_NVT
	select CEVT_R4K
	select CSRC_R4K
	select MIPS_CPU_SCACHE
	select SYS_HAS_CPU_MIPS32_R2
	select SYS_HAS_EARLY_PRINTK
	select SYS_SUPPORTS_32BIT_KERNEL
	select SYS_SUPPORTS_LITTLE_ENDIAN
	select SYS_SUPPORTS_MULTITHREADING
	select CPU_MIPSR2_IRQ_EI
	help
	  This enables support for the NovaTek nt72568 evaluation
	  board.

endchoice

config PULLOUT_INITRAMFS
	bool "Pull-out Initramfs source file from kernel image"
	default n
	help
	  Enable this to pull-out initramfs_data.cpio.gz from vmlinux.

config INITRAMFS_IMG_HDR_ADDR
	hex "Location info of __initramfs_start and __initramfs_end"
	depends on PULLOUT_INITRAMFS
	default 0x88000000
	help
	  The first word contains __initramfs_start. And the second word contains __initramfs_end. 

config SET_CLOCK_MANUALLY
  bool "Set clock manually"
  default y

config CPU_CLOCK
  int "CPU clock setting (Hz)"
  depends on SET_CLOCK_MANUALLY
  default 25000000

config AHB_CLOCK
  int "AHB clock setting (Hz)"
  depends on SET_CLOCK_MANUALLY
  default 12000000

config IRQ_CPU_NVT
	depends on NVT_CHIP
	default y
	bool

endmenu
```
