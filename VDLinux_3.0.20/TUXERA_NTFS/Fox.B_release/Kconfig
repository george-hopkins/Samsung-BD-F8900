## VDLinux_3.0.20/linux-3.0.20/drivers/Kconfig.DEBUG
```kconfig
menu "Samsung SP DEBUG patch"
comment "VDLinux Debug patch"

config VD_RELEASE
    default n
    bool "Turn on Release mode"
    help
     Set Debug/Release mode (n : Debug / y : Release)

config UNHANDLED_IRQ_TRACE_DEBUGGING
   bool "trace unhandled irq tracing"
   depends on VD_RELEASE=n
   default n

config FIND_LONG_TIME_IRQ_HANDLER
   bool "trace irq handler which takes long time(> 1s)"
   depends on UNHANDLED_IRQ_TRACE_DEBUGGING=y
   default n

config CHECK_MOUNT_DEBUG
   bool "mount debugging"
   depends on VD_RELEASE=n
   default n

config FCOUNT_DEBUG
   bool "print f_count when umount fail(task info also is printed when CONFIG_FD_PID is enable) "
   depends on VD_RELEASE=n
   default n

config RUN_TIMER_DEBUG
   bool "run timer debugging"
   depends on VD_RELEASE=n

config UART_BROADCAST
   bool "tty broadcast"
   depends on VD_RELEASE=n
   default n

config NT13_DEBUG
   bool "NT13 debug"
   depends on VD_RELEASE=n && NVT_NT72568=y
   default y

config X12_DEBUG
   bool "X12 debug"
   depends on VD_RELEASE=n && MSTAR_EDISON=y
   default y

config SCHED_HISTORY_ON_DDR
    bool "Schedule history logger(pid,thread name, pc, sp ...) to ddr"
    depends on VD_RELEASE=n && DTVLOGD_EMERGENCY_LOG=y
    default y
    help
     It write down schedule history to ddr memory.
	(This data is written to end of e-log buffer)

config OPEN_FILE_CHECKER
	bool "In case of too many open files, It prints open file information"
    depends on VD_RELEASE=n
	default y
	help
	 It prints open file information.
	 also if the FD_PID is enabled, open thread information is supported.

config IRQ_TIME
   bool "IRQ_TIME"
   default n
   depends on VD_RELEASE=n
   help
     It prints the time of irqs

config SUPPORT_REBOOT
   bool "FORCE reboot when oops, coredump, hung task and watchdoc happens)"
   default y
   depends on VD_RELEASE=n
   help
     reboot target when problem happen

config ENABLE_REBOOT
	bool "enable REBOOT Setting"
   default n
   depends on SUPPORT_REBOOT=y

config SUPPORT_MSG_WITH_REBOOT
	bool "support print message when oops, coredump, hung task and watchdoc happens)"
   default y
   depends on SUPPORT_REBOOT=y

config ENABLE_MSG_WITH_REBOOT
	bool "enable oops, coredump message print Setting"
   default n
   depends on SUPPORT_REBOOT=y
endmenu
```

## VDLinux_3.0.20/linux-3.0.20/drivers/cma-hdma/Kconfig
```kconfig
# Selet this for platforms/machines that implemented code making
# the CMA test device usable.
config CMA_DEVICE_POSSIBLE
	bool

config CMA_DEVICE
	tristate "CMA device"
	depends on CMA
	help
	  The CMA misc device allows allocating contiguous memory areas
	  from user space.  This is for testing of the CMA framework.

	  If unsure, say "n"

config HDMA_DEVICE
	tristate "HDMA device"
	depends on HDMA
	help
	  The HDMA misc device allows allocate and free whole memory in
	  HDMA regions.

	  If unsure, say "n"
```

## VDLinux_3.0.20/linux-3.0.20/drivers/fsr/Kconfig
```kconfig
#
# Unified Flash Device configuration
#

menu "LinuStoreIII(FSR) Flash Devices Support"

config RFS_FSR
	tristate "FSR BML block device support"
	default m
	help
		Provides Flexible Sector Remapper(FSR) and associated BML block interface.

config RFS_FSR_STL
	tristate "FSR STL block device support"
	depends on RFS_FSR
	select RFS_MAPDESTROY
	default m
	help
		Provides STL block interface for FSR.

config RFS_STL_DELETE
	bool "STL delete support"
	depends on RFS_FSR_STL
	default y
	help
		STL delete support

config RFS_FSR_STL_BENCHMARK
	tristate "FSR benchmark tool support"
	depends on RFS_FSR
	help
		FSR benchmark tool.

config FSR_DUAL_VOLUME
	bool "Multi Volume support (Experimental)"
	depends on RFS_FSR
	default n
	help
		Support Dual Samsung flash memory devices.

config FSR_FLASH_PHYS_ADDR
	hex "1st Volume flash device Physical Location"
	depends on RFS_FSR
	default "0x00100000"
	help
		This is the physical address of the flash device the fsr will
		be linked for and stored to.  This address is platform dependent.

config FSR_FLASH_PHYS_ADDR2
	hex "2nd Volume flash device Physical Location"
	depends on FSR_DUAL_VOLUME
	default "0x0A000000"
	help
		This is the physical address of the 2nd flash device(in Multi Volume
		configuration) the fsr will be linked for and stored to. This
		address is platform dependent.

config LINUSTOREIII_DEBUG_VERBOSE
	int "LinuStoreIII Debugging verbosity (0 = quiet, 3 = noisy)"
	depends on RFS_FSR
	default 0

config LINUSTOREIII_DEBUG
	bool
	depends on RFS_FSR
	default y

endmenu
```

## VDLinux_3.0.20/linux-3.0.20/drivers/gzmanager/Kconfig
```kconfig
config GZMANAGER
	bool "gunzipManager HW/SW decompressor"
	default y
	select ZLIB_INFLATE
	help
      The gunzipManager is a fast and efficient method to 
      decompress the compressed block with gzip format
      The gunzipManager will decompress the data on each core.

config GZM_ZLIB
	bool "gunzipManager ZLIB Support"
	default y
	depends on GZMANAGER
	help
      The gunzipManager module with zlib compress /decompress  
      support. 

config GZMANAGER_TEST
	bool "gunzipManager Test Module"
	default n
	depends on GZMANAGER
	help
      The gunzipManager module is used to test the  
      gunzipManager functionality for giving the data to the 
      gunzipManager and decompress using direct and indirect 
      calls.
```

## VDLinux_3.0.20/linux-3.0.20/drivers/mstar/Kconfig
```kconfig
# drivers/MStar/Kconfig

menu "MStar Platform Configuration"

#===================================================
# MStar Chip Selection
#===================================================
choice
	prompt "MStar Chip Selection"
	default None

config MSTAR_NONE
	bool "None"


config MSTAR_AMBER3
        bool "AMBER3"
	select ARCH_SPARSEMEM_ENABLE
	select COMMON_CLKDEV
        help
          This enables support for the ARM Ltd Versatile Express boards.

config MSTAR_EDISON
        bool "EDISON"
	select ARCH_SPARSEMEM_ENABLE
	select COMMON_CLKDEV
        select PLAT_MSTAR
        help
          This enables support for the ARM Ltd Versatile Express boards.

config MSTAR_EMERALD
        bool "Emerald"
        select BOOT_ELF32
        select ARCH_SPARSEMEM_ENABLE
        select DMA_NONCOHERENT
        select MIPS_BOARDS_GEN
        select CEVT_R4K
        select CSRC_R4K
        select IRQ_CPU
        select SYS_HAS_CPU_MIPS32_R2
        select SYS_HAS_EARLY_PRINTK
        select SYS_SUPPORTS_32BIT_KERNEL
        select SYS_SUPPORTS_LITTLE_ENDIAN
        select SYS_SUPPORTS_MULTITHREADING
        select MS_USB_MIU1_PATCH
        select SYS_SUPPORTS_HIGHMEM
        select CPU_HAS_SYNC
	select CPU_HAS_LLSC
	select CPU_MIPSR2_IRQ_VI
	help
	  This enables support for SEC X9 board
	  board.

endchoice

#===================================================
# MStar Chip (auto-select)
# 0: None
#===================================================
config MSTAR_CHIP_TYPE
	int
	default 0

#===================================================
# MStar Chip Name (auto-select)
#===================================================
config MSTAR_CHIP_NAME
	string
	default "amber3" if MSTAR_AMBER3
	default "edison" if MSTAR_EDISON
        default "emerald" if MSTAR_EMERALD
	default "error"

#===================================================
# USB MIU1 PATCH
#===================================================
config MS_USB_MIU1_PATCH
    bool
    default n

#===================================================
# USB PATCH
#===================================================
config MSTAR_COOCAA_AUTH
    bool "Link with COOCAA Authorization"
    default n

if !MSTAR_NONE
#==========================================
# Remove this latter - cc.chen
#==========================================
source "drivers/mstar/Kconfig-Board"
source "drivers/mstar/Kconfig-MMap"

#===================================================
# MStar Device Drivers
#===================================================
comment "MStar Device Drivers"
#source "drivers/mstar/g3d/Kconfig"
#source "drivers/mstar/iomap/Kconfig"
#source "drivers/mstar/msystem/Kconfig"
#source "drivers/mstar/mpool/Kconfig"
#source "drivers/mstar/ramdisk/Kconfig"
#source "drivers/mstar/gpio/Kconfig"
#source "drivers/mstar/iic/Kconfig"
source "drivers/mstar/emac/Kconfig"
source "drivers/mstar/usb/Kconfig"
#source "drivers/mstar/system/Kconfig"
#source "drivers/mstar/ir/Kconfig"
#source "drivers/mstar/nand/Kconfig"
#source "drivers/mstar/flash/Kconfig"
#source "drivers/mstar/mbx/Kconfig"
#source "drivers/mstar/fusion/Kconfig"
#source "drivers/mstar/firmware/Kconfig"
#source "drivers/mstar/onenand/Kconfig"
#source "drivers/mstar/gflip/Kconfig"
#source "drivers/mstar/rfid/Kconfig"
#source "drivers/mstar/vid_pre_alloc_mem/Kconfig"
#source "drivers/mstar/msglog/Kconfig"
#source "drivers/mstar/tsp/Kconfig"
#source "drivers/mstar/shire/Kconfig"
#source "drivers/mstar/sc/Kconfig"
#source "drivers/mstar/mpif/Kconfig"
#source "drivers/mstar/alsa_audio_driver/Kconfig"
#source "drivers/mstar/uarttp/Kconfig"
endif

endmenu
```
