## VDLinux_3.0.20/TUXERA_NTFS/Fox.B_release/Kconfig
```kconfig
config TNTFS_FS
	tristate "TNTFS file system support"
	default m
	select NLS
	help
	  NTFS is the file system of Microsoft Windows NT and later.

	  To compile this file system support as a module, choose M here: the
	  module will be called ntfs.
```

## VDLinux_3.0.20/exFATs/exFAT.Fox.B_release/Kconfig
```kconfig
config EXFAT_FS
	tristate "exfat support"
	select NLS
	default m
	help
	  If you want to use one of the FAT-based file systems (the MS-DOS and
	  VFAT (Windows 95) file systems), then you must say Y or M here
	  to include FAT support. You will then be able to mount partitions or
	  diskettes with FAT-based file systems and transparently access the
	  files on them, i.e. MSDOS files will look and behave just like all
	  other Unix files.

	  This FAT support is not a file system in itself, it only provides
	  the foundation for the other file systems. You will have to say Y or
	  M to at least one of "MSDOS fs support" or "VFAT fs support" in
	  order to make use of it.

	  Another way to read and write MSDOS floppies and hard drive
	  partitions from within Linux (but not transparently) is with the
	  mtools ("man mtools") program suite. You don't need to say Y here in
	  order to do that.

	  If you need to move large files on floppies between a DOS and a
	  Linux box, say Y here, mount the floppy under Linux with an MSDOS
	  file system and use GNU tar's M option. GNU tar is a program
	  available for Unix and DOS ("man tar" or "info tar").

	  The FAT support will enlarge your kernel by about 37 KB. If unsure,
	  say Y.

	  To compile this as a module, choose M here: the module will be called
	  fat.  Note that if you compile the FAT support as a module, you
	  cannot compile any of the FAT-based file systems into the kernel
	  -- they will have to be modules as well.

config EXFAT_DEFAULT_CODEPAGE
	int "Default codepage for exfat"
	depends on MSDOS_FS || VFAT_FS
	default 437
	help
	  This option should be set to the codepage of your FAT filesystems.
	  It can be overridden with the "codepage" mount option.
	  See <file:Documentation/filesystems/vfat.txt> for more information.
```

## VDLinux_3.0.20/linux-3.0.20/arch/arm/Kconfig.SPBSP
```kconfig
menu "Samsung SP/BSP options"
comment "VDLinux 3.x SP/BSP patch"

config BLOCK_STOP_TTY
       bool "block stop_tty (Ctrl + S)"
       default y
       help
        Noise from UART can make stop signal. This option blocks stop_tty.

config DIRTY_BACKGROUND_RATIO
               int "Dirty background ratio"
               default 10
               help
                       set dirty background ratio for waking up pdflush kernel thread.

config DIRTY_EXPIRE_INTERVAL
               int "Dirty expire interval"
               default (3000)
               help
                       set interval value expiring dirty pages for page writeback operation.

config BUSYLOOP_WHILE_OOPS
               bool "busyloop while oops"
               default y
               help
                In case of oops, This option is useful for attach JTAG device.

config PROHIBIT_SIGNAL_HOOKING
                bool "coredump when user try signal_hooking"
                default n
                help
                 In case of user app trying signal hooking, This option can stop user app and create coredump.

config PROHIBIT_USLEEP_0
                bool "coredump when user try usleep(0)"
                default n
                help
                 In case of user app using usleep(0), This option can stop user app and create coredump.

config MODULE_VER_CHECK_SKIP
       bool "Module version check skip"
       default n
       depends on MODVERSIONS=n
       help
         'PRINT_MODULE_ADDR' option change VERMAGIC_STRING value. (e.g. 1003_192 DEBUG)
         so, If you are using different version name, insmod will be failed
         even while 'MODVERSION' option is off.
         This option skip the checking the VERMAGIC_STRING.

config SQUASHFS_DEBUGGER
       bool "squashfs debugger v2.0"
       default y
       help
         Tool for debugging squashfs error.
         It is useful even to debug Flash I/O and memory un-safe problem.

config SQUASHFS_DEBUGGER_AUTO_DIAGNOSE
       bool "squashfs debugger auto diagnose"
       default y
       depends on SQUASHFS_DEBUGGER
       help
         Diagnose the cause of squashfs error.

config SQUASHFS_BLOCK_SIZE_1K_TO_4K
		bool "squashfs block size 1K => 4K"
		default y
		help
		  In most of case, To set block size as 4K enhance the performance.
 
config MMC_BOOTING_SYNC
		bool "Wait rootfs mount try till mmc scan is done"
		default y
		help
		  If you use mmc device for rootfs, It could prevent mount fail issue.

config HPI_FEATURE
		bool "eMMC HPI Feature"
		default n
		help
		  This config decides whether it uses HPI feature or not.

config CA9_SYSTEM_HANG
		bool "CA9 SYSTEM HANG"
		default n
		help
		  This config decides whether it uses flush BTAC/BTB( Branch Target Buffer ) when context switch

config MMC_QUEUE_BOUNCESZ 
		int "MMC memory card bounce buffer size"
		range 16 1024
		default 64
		help
		  Provide a flexible method to adjust bounce buffer size

config MMC_TIMEOUT
		bool "MMC_TIMEOUT"
		default n
		help
		  This config stops current mmc request.

endmenu # end of "Samsung SP/BSP options" menu
```

## VDLinux_3.0.20/linux-3.0.20/arch/arm/Kconfig.Secure
```kconfig
#menu Samsung

## SELP Menu Start: config file  for SELP Features #############################
## MS.PARK 08.07
menu "CI+ Option"

config EXECUTE_AUTHULD
       default n
       bool "Execute authuld program on background"
       help
         decide whether executing authuld

config RSA2048
	bool "RSA2048 setting"
	default y if MSTAR_EDISON || ARCH_SDP1202 || ARCH_SDP1207 # X12, FoxP, FoxB
        depends on EXECUTE_AUTHULD=y

config SHUTDOWN
        bool "Send shutdown signal to micom"
        default n
        depends on EXECUTE_AUTHULD=y
        help
          decide whether send "shutdown" to micom or not

config AUTHULD_PATH
        string "Path to authuld file"
        default "/bin/authuld"
        depends on EXECUTE_AUTHULD=y
        help
          Allows to redirect authuld files into specified location.

config TIMEOUT_ACK_AUTHULD
        int "Timout of authuld ack(minute)"
        default 3
        depends on EXECUTE_AUTHULD=y
        help
          if kernel do not get ACK from authuld, System will be down.

config MOUNT_SECURITY
	bool "security on mount command"
	default n
	help
	  In case of release kernel build mode, This option will disable BIND option and apply NOEXEC option to all devices on mount command 

config USE_ARS
	bool "Anit RemoteShell Dummy function"
	default n

config PNACL
	bool "Modification for PNaCl"
	default n
	
endmenu # end of "CI+ Option" menu

#endmenu
```

## VDLinux_3.0.20/linux-3.0.20/arch/arm/arm-boards/Kconfig
```kconfig
menu "Mstar platform type"
	depends on ARCH_MSTAR

config ARCH_MSTAR_CA9X4
	bool "Mstar Cortex-A9x4 tile"
	select CPU_V7
	select ARM_GIC
#	select ARM_ERRATA_720789
#	select ARM_ERRATA_751472
#	select ARM_ERRATA_753970

endmenu
```

## VDLinux_3.0.20/linux-3.0.20/arch/arm/arm-boards/plat-mstar/Kconfig
```kconfig
if PLAT_MSTAR

config PLAT_MSTAR_SCHED_CLOCK
	def_bool y if !ARCH_INTEGRATOR_AP
	select HAVE_SCHED_CLOCK

endif
```

## VDLinux_3.0.20/linux-3.0.20/arch/arm/mach-ccep/Kconfig
```kconfig
######################################################################
#
# 	Kconfig for machine about Costom Consumer Electronics 
# 	
# 	created by tukho.kim@samsung.com
#
######################################################################
#
# May,31,2010:	created by tukho.kim
# 

if ARCH_CCEP

choice 
	prompt "Consumer Electronics"
	default SAMSUNG_VD_DTV_PLATFORM

config  SAMSUNG_VD_DTV_PLATFORM
	bool "Samsung VD DTV Platform"
	help
	  This enables support for Samsung co. VD SoC R&D Group DTV Platform

config  SAMSUNG_VD_BD_PLATFORM
	bool "Samsung VD Blue-ray Platform"
	help
	  This enables support for Samsung co. VD SoC R&D Group Blue-ray Platform
endchoice # Consumer Electronics


if SAMSUNG_VD_DTV_PLATFORM
source "arch/arm/mach-ccep/Kconfig.dtv" 
endif # SAMSUNG_VD_DTV_PLATFORM

if SAMSUNG_VD_BD_PLATFORM
source "arch/arm/mach-ccep/Kconfig.bd" 
endif # SAMSUNG_VD_BD_PLATFORM


#
# Define Core
#
	
config ARCH_CCEP_SOC_CA8
	bool
	select CPU_V7

config ARCH_CCEP_SOC_CA9
	bool
	select CPU_V7

config ARCH_CCEP_SOC_CA15
	bool
	select CPU_V7

config ARCH_CCEP_FPGA
	bool "CCEP FPGA board"
	default n

config ARCH_SDP1202_EVAL
	bool "SDP1202 Eval board"
	depends on ARCH_SDP1202

config ARCH_SDP1207_EVAL
	bool "SDP1207 Eval board"
	depends on ARCH_SDP1207

config ARCH_CCEP_SMP
	bool "SDP SoC Support SMP"
	depends on ARCH_CCEP_SOC_CA9 || ARCH_CCEP_SOC_CA15
	depends on !ARCH_SDP1004 || !ARCH_SDP1004FPGA
	default y
	default n if ARCH_CCEP_FPGA
	select SMP
	select ARM_GIC

config ARCH_CCEP_GIC
	bool "SDP SoC Enable GIC"
	depends on ARCH_CCEP_SOC_CA9 || ARCH_CCEP_SOC_CA15
	depends on !ARCH_SDP1004 || !ARCH_SDP1004FPGA || !ARCH_CCEP_SMP
	default y
	select ARM_GIC

config ARCH_CCEP_ENABLE_VFP
	bool "SDP SoC Enable VFP"
	depends on CPU_V7
	default y
	default n if ARCH_CCEP_FPGA && ARCH_CCEP_SOC_CA15
	select VFP

config ARCH_CCEP_DISABLE_VFP
	depends on !ARCH_CCEP_ENABLE_VFP
	def_bool y

config ARCH_CCEP_ENABLE_NEON
	bool "SDP SoC Enable NEON"
	depends on CPU_V7 && ARCH_CCEP_ENABLE_VFP
	default y
	default n if ARCH_CCEP_FPGA
	select NEON

config ARCH_CCEP_DISABLE_NEON
	depends on !ARCH_CCEP_ENABLE_NEON
	def_bool y

config ARCH_CCEP_SOC_PL310
	bool "SDP SoC PL310 L2 Cache controller"
	depends on ARCH_CCEP_SOC_CA9
	default y
	default n if ARCH_CCEP_FPGA
	select CACHE_L2X0
	select CACHE_PL310

# Define Core End


#
# Discontigmem support 
#
config MACH_MEMORY_TYPE_SUPPORT
	bool 

if MACH_MEMORY_TYPE_SUPPORT

choice
	prompt "Choose System Memory Type"
	default SDP_SPARSEMEM_SUPPORT

config SDP_SPARSEMEM_SUPPORT
	bool "Sparse memory support"
	select ARCH_SPARSEMEM_ENABLE
	help
	  This enables support sparse memory.

config SDP_DISCONTIGMEM_SUPPORT
	bool "discontinous memory support"
	select ARCH_DISCONTIGMEM_ENABLE
	help
	  This enables support discontinous memory for 2 channel system memory 

config SDP_SINGLE_DDR_A
	bool "only DDR A channel system memory"
	help
	  This enables support only to use A channel for system memory

config SDP_SINGLE_DDR_B
	bool "only DDR B channel system memory"
	help
	  This enables support only to use B channel for system memory

config SDP_SINGLE_DDR_C
	bool "only DDR C channel system memory"
	help
	  This enables support only to use C channel for system memory

endchoice # "Choose System Memory Type"

config USE_EXT_GIC
	bool "Use external GIC and interrupt combiner"
	depends on ARCH_SDP1202 || ARCH_SDP1202FPGA
	help
	  Use external GIC and interrupt combiner
	  instead of internal GIC and interrupt combiner.

config HAVE_ARM_GT
	bool "Use ARM Generic Timer for A7/A15"
	depends on ARCH_CCEP_SOC_CA15
	default y if ARCH_CCEP_SOC_CA15
	select TICK_ONESHOT
	help
	  Use ARM Generic Timer for A7/A15.	  

menu "Select ARM Errata Patch"

config SDP_ARM_A8_ERRATA_586324
	bool "ARM A8 ERRATA 586324 - cache corruption"
	depends on ARCH_CCEP_SOC_CA8
	default y if ARCH_CCEP_SOC_CA8
	help
	  This fix ARM_ERRATA_586324. Cache maintenance operation done by MVA can result in a corruption of memory.

config SDP_ARM_PL310_ERRATA_752271
	bool "ARM_PL310_ERRATA_752271 - Double linefill feature can cause data corruption"
	depends on ARCH_CCEP_SOC_CA9
	default y if ARCH_CCEP_SOC_CA9 && !ARCH_SDP1207 && !ARCH_SDP1207FPGA
	help
	  This fix PL310_ERRATA_752271. Double linefill feature can cause data corruption.

endmenu

endif # MACH_MEMORY_TYPE_SUPPORT

endif # ARCH_CCEP	
```

## VDLinux_3.0.20/linux-3.0.20/arch/arm/mach-ccep/Kconfig.bd
```kconfig
######################################################################
#
# 	Kconfig for Samsung VD SoC BD platform
# 	
# 	created by tukho.kim@samsung.com
#
######################################################################
#
# May,31,2010:	created by tukho.kim
# 

if SAMSUNG_VD_BD_PLATFORM

choice 
	prompt "BD Platform (machine)"
	default MACH_FIRENZE

config MACH_FIRENZE
	bool "Firenze platform, 2010"
	select ARCH_SDP1004
	select MACH_MEMORY_TYPE_SUPPORT
	help
	  This enables support for Samsung VD DTV Evaluation board, FIRENZE.

config MACH_FPGA_FIRENZE
	bool "Firenze FPGA platform, 2010"
	select ARCH_SDP1004FPGA
	select MACH_MEMORY_TYPE_SUPPORT
	help
	  This enables support for Samsung VD DTV FPGA board, FIRENZE.

config MACH_VICTORIA
	bool "Victoria platform, 2011"
	select ARCH_SDP1105
	select MACH_MEMORY_TYPE_SUPPORT
	help
	  This enables support for Samsung VD DTV Evaluation board, VICTORIA.

config MACH_FPGA_VICTORIA
	bool "Victoria FPGA platform, 2011"
	select ARCH_SDP1105FPGA
	select MACH_MEMORY_TYPE_SUPPORT
	help
	  This enables support for Samsung VD FPGA board, VICTORIA.

config MACH_FPGA_FOXB
	bool "Fox-B FPGA platform, 2012"
	select ARCH_SDP1207FPGA
	select MACH_MEMORY_TYPE_SUPPORT
	help
	  This enables support for Samsung VD FPGA board, Fox B FPAG .

config MACH_FOXB
	bool "Fox-B platform, 2012"
	select ARCH_SDP1207
	select MACH_MEMORY_TYPE_SUPPORT
	help
	  This enables support for Samsung VD BD Evaluation board, FoxB.

endchoice #"BD Platform (machine)"


endif #SAMSUNG_VD_BD_PLATFORM

#Firenze CA9 Single
config ARCH_SDP1004
	bool
	select ARCH_CCEP_SOC_CA9

#Firenze CA9 Single
config ARCH_SDP1004FPGA
	bool
	select ARCH_CCEP_SOC_CA9
	select ARCH_CCEP_FPGA

#Echo-B CA9 Dual
config ARCH_SDP1105
	bool
	select ARCH_CCEP_SOC_CA9
#	select ARM_ERRATA_743622
#	select ARM_ERRATA_751472
#	select ARM_ERRATA_754322
#	select ARM_ERRATA_764369

#Echo-B CA9 Dual
config ARCH_SDP1105FPGA
	bool
	select ARCH_CCEP_SOC_CA9
	
#Fox-B CA9 Dual
config ARCH_SDP1207FPGA
	bool
	select ARCH_CCEP_SOC_CA9
	select ARM_ERRATA_743622
	select ARM_ERRATA_751472
	select ARM_ERRATA_754322
	select ARM_ERRATA_764369

#Fox-B CA9 Dual
config ARCH_SDP1207
	bool
	select ARCH_CCEP_SOC_CA9
	select ARM_ERRATA_754322
	select ARM_ERRATA_764369
	select SDP_MAC_NORMAL_DESC if SDP_MAC

config SATA_FIRENZE
	tristate	"Support VD BD SATA"
	depends on ARCH_SDP1004 || ARCH_SDP1105 || ARCH_SDP1105FPGA || ARCH_SDP1207FPGA || ARCH_SDP1207
#	select ATA
	select ATA_SFF
	select SATA_PMP

#
# Define BD SoC chip 
#

if MACH_FIRENZE
source "arch/arm/mach-ccep/platform/firenze/Kconfig"
endif

if MACH_FPGA_FIRENZE
source "arch/arm/mach-ccep/platform/fpga_firenze/Kconfig"
endif

if MACH_VICTORIA
source "arch/arm/mach-ccep/platform/victoria/Kconfig"
endif

if MACH_FPGA_VICTORIA
source "arch/arm/mach-ccep/platform/fpga_victoria/Kconfig"
endif

if MACH_FPGA_FOXB
source "arch/arm/mach-ccep/platform/fpga_foxb/Kconfig"
endif

if MACH_FOXB
source "arch/arm/mach-ccep/platform/foxb/Kconfig"
endif
```
